&i2c_2 {
	sar_sx9310:sx9310@28 {
		compatible = "semtech,sx9310";
		reg = <0x28>;
		pinctrl-names = "default";
		pinctrl-0 = <&sx9310_int_default>;
		interrupt-parent = <&tlmm>;
		interrupts = <59 0x2002>;
		cap_vdd-supply = <&pm8937_l10>;
		cap_svdd-supply = <&pm8937_l5>;
		gpios = <&tlmm 59 0x2008>; /* IRQ */
		cap,use_channel = <0x0f>;
		cap,use_channel_top = <0x00>;
		cap,use_channel_bottom = <0x02>;
		cap,raw_data_channel = <0x01>;
		cap,scan_period = <0x02>;
		reg_array_len = <11>;
		reg_array_val = <0x12 0x03 0x13 0x0a 0x15 0xc2 0x16 0x30 0x17 0x4b 0x18 0x41 0x19 0x41 0x1a 0x18 0x21 0x1a 0x22 0x08 0x23 0x20>;
	};

	sar_abov:abov@20 {
		compatible = "abov,abov_sar";
		reg = <0x20>;
		cap_vdd-supply = <&pm8937_l10>;
		cap_svdd-supply = <&pm8937_l5>;
		interrupt-parent = <&tlmm>;
		interrupts = <59 0x2008>;
		gpios = <&tlmm 59 0x2008>; /* IRQ */
		pinctrl-names = "default";
		pinctrl-0 = <&sx9310_int_default>;
		cap,use_channel_top = <0x01>;
		cap,use_channel_bottom = <0x00>;
		reg_array_len = <0>;
		reg_array_val = <>;
	};
};
