&soc {
	sound {
		/delete-property/ qcom,cdc-us-eu-gpios;
		/delete-property/ qcom,cdc-us-euro-gpios;
		/delete-property/ qcom,quin-mi2s-gpios;
		qcom,msm-micbias1-ext-cap;
		/delete-property/ qcom,msm-micbias2-ext-cap;
		qcom,msm-hs-micbias-type = "external";
		qcom,audio-routing =
			"RX_BIAS", "MCLK",
			"INT_LDO_H", "MCLK",
			"MIC BIAS External", "Handset Mic",
			"MIC BIAS External2", "Headset Mic",
			"MIC BIAS External", "Secondary Mic",
			"AMIC1", "MIC BIAS External",
			"AMIC2", "MIC BIAS External2",
			"AMIC3", "MIC BIAS External";
	};
};
