&mot_batterydata {
	qcom,batt-id-range-pct = <15>;
	#include "../batterydata/batterydata-bl270-lg64-pmi8937.dtsi"
	#include "../batterydata/batterydata-bl270-lg32-pmi8937.dtsi"
	#include "../batterydata/batterydata-gk40-atl.dtsi"
};

&qpnp_smbcharger {
	qcom,fastchg-current-ma = <1850>;
	qcom,chg-thermal-mitigation = <1850>, <1600>, <1200>, <1000>,
					<700>, <400>;
	/delete-property/ qcom,dc-thermal-mitigation;
	qcom,parallel-charge-current-map = <1850 1850 0>,
					<1600 1600 0>,
					<1200 1200 0>,
					<1000 1000 0>,
					<700 700 0>,
					<400 400 0>;
	qcom,stepchg-voltage-mv = <4200>;
	qcom,stepchg-current-ma = <1850>;
	qcom,stepchg-taper-ma = <1500>;
	qcom,stepchg-iterm-ma = <125>;
	/delete-property/ qcom,enable-hvdcp-9v;
	qcom,weak-charger-check-enable;
	qcom,temp-warm-current-ma = <1500>;
	qcom,temp-cool-current-ma = <700>;
	qcom,temp-slightly-cool-current-ma = <700>;
	qcom,slightly-cool-temp-c = <15>;
	qcom,enable-charging-limit;
	qcom,upper-limit-capacity = <75>;
	qcom,lower-limit-capacity = <60>;
};

&qpnp_fg {
	qcom,ext-sense-type; /* External Sense Resistor */
	qcom,thermal-coefficients =  /bits/ 16 <0xDA86 0xF050 0x083C>;
	qcom,irq-volt-empty-mv = <3200>;
	qcom,fg-cutoff-voltage-mv = <3400>;
	qcom,fg-iterm-ma = <300>;
};
