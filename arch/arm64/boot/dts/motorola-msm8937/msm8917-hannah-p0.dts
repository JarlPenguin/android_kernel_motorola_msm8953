/* Copyright (c) 2016, Motorola Mobility Inc. All rights reserved.
 *
 * This program is free software; you can redistribute it and/or modify
 * it under the terms of the GNU General Public License version 2 and
 * only version 2 as published by the Free Software Foundation.
 *
 * This program is distributed in the hope that it will be useful,
 * but WITHOUT ANY WARRANTY; without even the implied warranty of
 * MERCHANTABILITY or FITNESS FOR A PARTICULAR PURPOSE.  See the
 * GNU General Public License for more details.
 */

/dts-v1/;

#include "qcom/msm8917.dtsi"

#define SOC_MSM8917
#include "common/common.dtsi"

#define DEVICE_RHANNAH
#include "hannah/hannah.dtsi"

/ {
	model = "hannah";
	compatible = "qcom,msm8917-hannah", "qcom,msm8917-moto",
			"qcom,msm8917";

	qcom,board-id = <0x44 0x8000>;

	motorola,variant = "rhannah";
};
