&mot_batterydata {
	qcom,batt-id-range-pct = <15>;
	#include "../batterydata/batterydata-bl270-lg64-pmi8937.dtsi"
	#include "../batterydata/batterydata-bl270-lg32-pmi8937.dtsi"
	#include "../batterydata/batterydata-gk40-atl.dtsi"
};

&qpnp_smbcharger {
	qcom,fastchg-current-ma = <2800>;
#ifdef DEVICE_JETER
	qcom,chg-thermal-mitigation = <2800>, <2300>,<1800>, <1500>,
					<1000>,<700>, <400>;
#else
	qcom,chg-thermal-mitigation = <2800>, <2300>,<1800>, <1500>,
					<1000>,<700>, <500>;
#endif
	/delete-property/ qcom,dc-thermal-mitigation;
#ifdef DEVICE_JETER
	qcom,parallel-charge-current-map = <2800 2800 0>,
					<2300 2300 0>,
					<1800 1800 0>,
					<1500 1500 0>,
					<1000 1000 0>,
					<700 700 0>,
					<400 400 0>;
#else
	qcom,parallel-charge-current-map = <2800 2800 0>,
					<2300 2300 0>,
					<1800 1800 0>,
					<1500 1500 0>,
					<1000 1000 0>,
					<700 700 0>,
					<500 500 0>;
#endif
	qcom,stepchg-voltage-mv = <4200>;
	qcom,stepchg-current-ma = <2000>;
	qcom,stepchg-taper-ma = <1800>;
	qcom,stepchg-iterm-ma = <125>;
	qcom,enable-hvdcp-9v;
	qcom,weak-charger-check-enable;
	qcom,temp-warm-current-ma = <1500>;
	qcom,temp-cool-current-ma = <700>;
	qcom,temp-slightly-cool-current-ma = <700>;
	qcom,slightly-cool-temp-c = <15>;
	qcom,enable-charging-limit;
	qcom,upper-limit-capacity = <75>;
	qcom,lower-limit-capacity = <60>;
};

&qpnp_fg {
	qcom,ext-sense-type; /* External Sense Resistor */
	qcom,thermal-coefficients =  /bits/ 16 <0xDA86 0xF050 0x083C>;
	qcom,irq-volt-empty-mv = <3200>;
	qcom,fg-cutoff-voltage-mv = <3400>;
	qcom,fg-iterm-ma = <300>;
};
