&qpnp_smbcharger {
	qcom,fastchg-current-ma = <3000>;
	qcom,chg-thermal-mitigation = <3000>, <2500>, <2000>, <1600>,
		<1000>, <500>, <300>;
	/delete-property/ qcom,dc-thermal-mitigation;
	qcom,parallel-charge-current-map = <3000 3000 0>,
					   <2500 2500 0>,
					   <2000 2000 0>,
					   <1600 1600 0>,
					   <1000 1000 0>,
					   <500 500 0>,
					   <400 400 0>;
	qcom,stepchg-voltage-mv = <4200>;
	qcom,stepchg-current-ma = <2000>;
	qcom,stepchg-taper-ma = <1800>;
	qcom,stepchg-iterm-ma = <125>;
	qcom,temp-warm-current-ma = <1500>;
	qcom,temp-cool-current-ma = <600>;
	qcom,temp-slightly-cool-current-ma = <600>;
	qcom,slightly-cool-temp-c = <15>;
	qcom,enable-charging-limit;
	qcom,upper-limit-capacity = <70>;
	qcom,lower-limit-capacity = <60>;
};

&qpnp_fg {
	qcom,ext-sense-type; /* External Sense Resistor */
	qcom,thermal-coefficients =  /bits/ 16 <0xb785 0xb249 0x7135>;
	qcom,low-batt-temp-comp;
};

&mot_batterydata {
	df-serialnum = "SB18C15119";
	#include "../batterydata/batterydata-hg30-atl.dtsi"
	#include "../batterydata/batterydata-hg30-swd.dtsi"
};
