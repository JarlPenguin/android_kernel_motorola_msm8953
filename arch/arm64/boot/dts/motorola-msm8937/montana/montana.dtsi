/* Copyright (c) 2016, Motorola Mobility Inc. All rights reserved.
 *
 * This program is free software; you can redistribute it and/or modify
 * it under the terms of the GNU General Public License version 2 and
 * only version 2 as published by the Free Software Foundation.
 *
 * This program is distributed in the hope that it will be useful,
 * but WITHOUT ANY WARRANTY; without even the implied warranty of
 * MERCHANTABILITY or FITNESS FOR A PARTICULAR PURPOSE.  See the
 * GNU General Public License for more details.
 */

#define SOC_MSM8937
#include "../common/common.dtsi"

#include "audio.dtsi"
#include "battery.dtsi"
#include "camera.dtsi"
#include "display.dtsi"
#include "fingerprint.dtsi"
#include "misc.dtsi"
#include "nfc.dtsi"
#include "pmi8950.dtsi"
#include "regulator.dtsi"
#include "sensor.dtsi"
#include "storage.dtsi"
#include "thermal.dtsi"
#include "touchscreen.dtsi"
#include "vibrator.dtsi"

/ {
	model = "montana";
	compatible = "qcom,msm8937-montana", "qcom,msm8937-moto",
			"qcom,msm8937";
};
