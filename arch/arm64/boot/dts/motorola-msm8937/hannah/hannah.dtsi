/* Copyright (c) 2016, Motorola Mobility Inc. All rights reserved.
 *
 * This program is free software; you can redistribute it and/or modify
 * it under the terms of the GNU General Public License version 2 and
 * only version 2 as published by the Free Software Foundation.
 *
 * This program is distributed in the hope that it will be useful,
 * but WITHOUT ANY WARRANTY; without even the implied warranty of
 * MERCHANTABILITY or FITNESS FOR A PARTICULAR PURPOSE.  See the
 * GNU General Public License for more details.
 */

#ifndef DEVICE_RHANNAH
#include "pinctrl.dtsi"
#endif

#include "audio.dtsi"
#include "battery.dtsi"
#include "camera.dtsi"
#include "display.dtsi"
#include "fingerprint.dtsi"
#include "misc.dtsi"
#include "pmi8950.dtsi"
#include "radio.dtsi"
#include "regulator.dtsi"
#include "sensor-sar.dtsi"
#include "storage.dtsi"
#include "thermal.dtsi"
#include "touchscreen.dtsi"
#include "vibrator.dtsi"
