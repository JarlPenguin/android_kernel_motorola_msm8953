/* Copyright (c) 2017, Motorola Mobility Inc. All rights reserved.
 *
 * This program is free software; you can redistribute it and/or modify
 * it under the terms of the GNU General Public License version 2 and
 * only version 2 as published by the Free Software Foundation.
 *
 * This program is distributed in the hope that it will be useful,
 * but WITHOUT ANY WARRANTY; without even the implied warranty of
 * MERCHANTABILITY or FITNESS FOR A PARTICULAR PURPOSE.  See the
 * GNU General Public License for more details.
 */

/dts-v1/;

#include "qcom/msm8920.dtsi"

#define SOC_MSM8920
#include "common/common.dtsi"

#define DEVICE_JETER
#include "jeter/jeter.dtsi"

/ {
        model = "jeter";
        compatible = "qcom,msm8920-jeter", "qcom,msm8920-moto",
                        "qcom,msm8920";

	qcom,board-id = <0x43 0x8000>;

	motorola,variant = "jeter";
};

&soc {
    sound {
	qcom,model = "msm8952-jeter-p0";
    };
};
